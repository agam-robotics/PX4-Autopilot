## src/drivers/serial_sensor_out/Kconfig
```kconfig
menuconfig DRIVERS_SERIAL_SENSOR_OUT
	bool "serial_sensor_out"
	default n
	---help---
		Output of optical flow, distance and IMU data over a serial port, for
		sensor nodes without a CAN connection. MAVLink for PX4 and ArduPilot,
		MSP for INAV and Betaflight.
```
